// AUTO-GENERATED from tools/message_gen/schema/messages_public.yaml by generate.py -- DO NOT EDIT.
// Change that schema and re-run tools/message_gen/generate.py (CI verifies they match).
[SYSCFG_K_P] = SYSCFG_F32(K_P, -1e+06f, 1e+06f),
[SYSCFG_K_I] = SYSCFG_F32(K_I, -1e+06f, 1e+06f),
[SYSCFG_K_D] = SYSCFG_F32(K_D, -1e+06f, 1e+06f),
[SYSCFG_PID_MAX_OUTPUT] = SYSCFG_F32(PID_MAX_OUTPUT, 1e-06f, 1e+06f),
[SYSCFG_THROTTLE_GAIN] = SYSCFG_F32(THROTTLE_GAIN, -1e+06f, 1e+06f),
[SYSCFG_BRAKE_GAIN] = SYSCFG_F32(BRAKE_GAIN, -1e+06f, 1e+06f),
[SYSCFG_HORIZONTAL_BIAS] = SYSCFG_F32(HORIZONTAL_BIAS, -1e+06f, 1e+06f),
[SYSCFG_VERTICAL_BIAS] = SYSCFG_F32(VERTICAL_BIAS, -1e+06f, 1e+06f),
[SYSCFG_MIN_DUTY_CYCLE_PERCENT] = SYSCFG_F32(MIN_DUTY_CYCLE_PERCENT, 0.0f, 1.0f),
[SYSCFG_MAX_DUTY_CYCLE_PERCENT] = SYSCFG_F32(MAX_DUTY_CYCLE_PERCENT, 0.0f, 1.0f),
[SYSCFG_MAX_FORCE_LBF] = SYSCFG_F32(MAX_FORCE_LBF, 0.001f, 100000.0f),
[SYSCFG_SESSIONCONTROLLER_TASK_OSDELAY] = SYSCFG_U32(SESSIONCONTROLLER_TASK_OSDELAY, 1u, 60000u),
[SYSCFG_BPM_TASK_OSDELAY] = SYSCFG_U32(BPM_TASK_OSDELAY, 1u, 60000u),
[SYSCFG_FORCESENSOR_TASK_OSDELAY] = SYSCFG_U32(FORCESENSOR_TASK_OSDELAY, 1u, 60000u),
[SYSCFG_FORCESENSOR_COMMAND_POLL_OSDELAY] = SYSCFG_U32(FORCESENSOR_COMMAND_POLL_OSDELAY, 1u, 60000u),
[SYSCFG_FORCESENSOR_CONVERSION_TIMEOUT_MS] = SYSCFG_U32(FORCESENSOR_CONVERSION_TIMEOUT_MS, 1u, 60000u),
[SYSCFG_OPTICAL_ENCODER_TASK_OSDELAY] = SYSCFG_U32(OPTICAL_ENCODER_TASK_OSDELAY, 1u, 60000u),
[SYSCFG_NUM_APERTURES] = SYSCFG_U32(NUM_APERTURES, 1u, 100000u),
[SYSCFG_PID_TASK_OSDELAY] = SYSCFG_U32(PID_TASK_OSDELAY, 1u, 60000u),
[SYSCFG_USB_TASK_OSDELAY] = SYSCFG_U32(USB_TASK_OSDELAY, 1u, 60000u),
[SYSCFG_USB_TX_FLUSH_MAX_RETRIES] = SYSCFG_U32(USB_TX_FLUSH_MAX_RETRIES, 0u, 1000u),
[SYSCFG_LCD_TASK_OSDELAY] = SYSCFG_U32(LCD_TASK_OSDELAY, 1u, 60000u),
[SYSCFG_LED_TASK_OSDELAY] = SYSCFG_U32(LED_TASK_OSDELAY, 1u, 60000u),
[SYSCFG_TASK_WARNING_RETRY_OSDELAY] = SYSCFG_U32(TASK_WARNING_RETRY_OSDELAY, 1u, 60000u),
[SYSCFG_TASK_MONITOR_TASK_OSDELAY] = SYSCFG_U32(TASK_MONITOR_TASK_OSDELAY, 1u, 60000u),
[SYSCFG_ADS1115_RATE] = SYSCFG_U32(ADS1115_RATE, 0u, 7u),
[SYSCFG_ADS1115_GAIN] = SYSCFG_U32(ADS1115_GAIN, 0u, 7u),
[SYSCFG_ADS1115_MUX] = SYSCFG_U32(ADS1115_MUX, 0u, 7u),
[SYSCFG_ADS1115_MODE] = SYSCFG_U32(ADS1115_MODE, 0u, 1u),
[SYSCFG_ADS1115_COMP_MODE] = SYSCFG_U32(ADS1115_COMP_MODE, 0u, 1u),
[SYSCFG_ADS1115_COMP_POL] = SYSCFG_U32(ADS1115_COMP_POL, 0u, 1u),
[SYSCFG_ADS1115_COMP_LAT] = SYSCFG_U32(ADS1115_COMP_LAT, 0u, 1u),
[SYSCFG_ADS1115_COMP_QUE] = SYSCFG_U32(ADS1115_COMP_QUE, 0u, 3u),
[SYSCFG_USB_MOCK_MESSAGES] = SYSCFG_U32(0u, 0u, 1u),
